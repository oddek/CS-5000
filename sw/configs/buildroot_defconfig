## sw/configs/buildroot_defconfig
```kconfig
BR2_arm=y
BR2_cortex_a9=y
BR2_ARM_ENABLE_NEON=y
BR2_ARM_ENABLE_VFP=y
BR2_ARM_FPU_NEON=y
BR2_TOOLCHAIN_EXTERNAL=y
BR2_TOOLCHAIN_EXTERNAL_CUSTOM=y
BR2_TOOLCHAIN_EXTERNAL_PATH="./../toolchain/x-tools/arm-cortexa9_neon-linux-gnueabihf/"
BR2_TOOLCHAIN_EXTERNAL_CUSTOM_PREFIX="arm-cortexa9_neon-linux-gnueabihf"
BR2_TOOLCHAIN_EXTERNAL_HEADERS_6_1=y
BR2_TOOLCHAIN_EXTERNAL_CUSTOM_GLIBC=y
# BR2_TOOLCHAIN_EXTERNAL_INET_RPC is not set
BR2_TOOLCHAIN_EXTERNAL_CXX=y
BR2_TOOLCHAIN_EXTERNAL_GDB_SERVER_COPY=y
BR2_TOOLCHAIN_EXTRA_LIBS="libstdc++"
BR2_ROOTFS_DEVICE_CREATION_DYNAMIC_EUDEV=y
BR2_TARGET_GENERIC_ROOT_PASSWD="root"
BR2_ROOTFS_OVERLAY="../configs/rootfs_overlay"
BR2_PACKAGE_BUSYBOX_SHOW_OTHERS=y
BR2_PACKAGE_P7ZIP=y
BR2_PACKAGE_ZSTD=y
BR2_PACKAGE_BPFTOOL=y
BR2_PACKAGE_GDB=y
BR2_PACKAGE_GDB_DEBUGGER=y
BR2_PACKAGE_GDB_TUI=y
BR2_PACKAGE_LATENCYTOP=y
BR2_PACKAGE_LIBBPF=y
BR2_PACKAGE_LMBENCH=y
BR2_PACKAGE_RT_TESTS=y
BR2_PACKAGE_SCHBENCH=y
BR2_PACKAGE_STRESS_NG=y
BR2_PACKAGE_TRACE_CMD=y
BR2_PACKAGE_VALGRIND=y
BR2_PACKAGE_BINUTILS_TARGET=y
BR2_PACKAGE_TREE=y
BR2_PACKAGE_SQUASHFS=y
BR2_PACKAGE_SQUASHFS_LZMA=y
BR2_PACKAGE_I2C_TOOLS=y
BR2_PACKAGE_SYSSTAT=y
BR2_PACKAGE_PERL=y
BR2_PACKAGE_PYTHON3=y
BR2_PACKAGE_PYTHON_BCC=y
BR2_PACKAGE_PYTHON_FUTURE=y
BR2_PACKAGE_PYTHON_NUMPY=y
BR2_PACKAGE_PYTHON_PYTEST=y
BR2_PACKAGE_PYTHON_PYTEST_RUNNER=y
BR2_PACKAGE_LIBXCRYPT=y
BR2_PACKAGE_LIBNL=y
BR2_PACKAGE_LIBNL_TOOLS=y
BR2_PACKAGE_LIBCAP=y
BR2_PACKAGE_LIBCAP_TOOLS=y
BR2_PACKAGE_LLVM=y
BR2_PACKAGE_LLVM_BPF=y
BR2_PACKAGE_SLANG=y
BR2_PACKAGE_IPERF3=y
BR2_PACKAGE_IPUTILS=y
BR2_PACKAGE_NETSTAT_NAT=y
BR2_PACKAGE_NTP=y
# BR2_PACKAGE_NTP_NTPD is not set
BR2_PACKAGE_NTP_NTPDATE=y
BR2_PACKAGE_OPENSSH=y
BR2_PACKAGE_PPPD=y
BR2_PACKAGE_RSYNC=y
BR2_PACKAGE_SOCAT=y
BR2_PACKAGE_BASH=y
BR2_PACKAGE_BASH_LOADABLE_EXAMPLES=y
BR2_PACKAGE_BASH_COMPLETION=y
BR2_PACKAGE_WHICH=y
BR2_PACKAGE_COREUTILS=y
BR2_PACKAGE_CPULIMIT=y
BR2_PACKAGE_CPULOAD=y
BR2_PACKAGE_HTOP=y
BR2_PACKAGE_PSMISC=y
BR2_PACKAGE_UTIL_LINUX_LIBFDISK=y
BR2_PACKAGE_VIM=y
BR2_TARGET_ROOTFS_EXT2=y
BR2_TARGET_ROOTFS_EXT2_3=y
BR2_TARGET_ROOTFS_EXT2_SIZE="1000M"
BR2_PACKAGE_HOST_DOSFSTOOLS=y
BR2_PACKAGE_HOST_DTC=y
BR2_PACKAGE_HOST_GENIMAGE=y
BR2_PACKAGE_HOST_KMOD=y
BR2_PACKAGE_HOST_MTOOLS=y
BR2_PACKAGE_HOST_PYTHON3=y
BR2_PACKAGE_HOST_UBOOT_TOOLS=y
BR2_PACKAGE_HOST_UBOOT_TOOLS_ENVIMAGE=y
BR2_PACKAGE_HOST_UBOOT_TOOLS_ENVIMAGE_SOURCE="board/altera/socrates_cyclone5/boot-env.txt"
BR2_PACKAGE_HOST_UBOOT_TOOLS_ENVIMAGE_SIZE="8192"
```
